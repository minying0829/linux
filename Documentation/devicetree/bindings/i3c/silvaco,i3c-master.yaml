## Documentation/devicetree/bindings/i3c/silvaco,i3c-master.yaml
```yaml
# SPDX-License-Identifier: GPL-2.0-only OR BSD-2-Clause
%YAML 1.2
---
$id: http://devicetree.org/schemas/i3c/silvaco,i3c-master.yaml#
$schema: http://devicetree.org/meta-schemas/core.yaml#

title: Silvaco I3C master

maintainers:
  - Conor Culhane <conor.culhane@silvaco.com>

allOf:
  - $ref: "i3c.yaml#"

properties:
  compatible:
    const: silvaco,i3c-master-v1

  reg:
    maxItems: 1

  interrupts:
    maxItems: 1

  clocks:
    items:
      - description: system clock
      - description: bus clock
      - description: other (slower) events clock

  clock-names:
    items:
      - const: pclk
      - const: fast_clk
      - const: slow_clk

  resets:
    maxItems: 1

  i3c-pp-scl-hi-period-ns:
    maxItems: 1
    minimum: 40
    maximum: 160
    description: |
      If need to configure SCL with required duty cycle, specify the clock high/low period directly.
      i3c-pp-scl-hi-perios-ns specifies the high period ns of the SCL clock cycle in push pull mode
      When i3c-pp-scl-hi-period-ns and i3c-pp-scl-lo-period-ns are specified, the i3c pp frequency is
      decided by these two properties.

  i3c-pp-scl-lo-period-ns:
    maxItems: 1
    minimum: 40
    maximum: 310
    description: |
      The low period ns of the SCL clock cycle in push pull mode. i3c-pp-scl-lo-period-ns should not
      be less than i3c-pp-scl-hi-period-ns and the maximal value is i3c-pp-scl-hi-period-ns + 150.

  i3c-od-scl-hi-period-ns:
    maxItems: 1
    description: |
      The i3c open drain frequency is 1MHz by default.
      If need to use different frequency, specify the clock high/low period directly.
      i3c-od-scl-hi-perios-ns specifies the high period ns of the SCL clock cycle in open drain mode.
      When i3c-od-scl-hi-period-ns and i3c-od-scl-lo-period-ns are specified, the i3c od frequency is
      decided by these two properties.
      i3c-od-scl-hi-period-ns should be equal to i3c-pp-scl-hi-period-ns or i3c-od-scl-lo-period-ns.

  i3c-od-scl-lo-period-ns:
    maxItems: 1
    minimum: 200
    description: |
      The low period ns of the SCL clock cycle in open drain mode. i3c-od-scl-lo-period-ns should be
      multiple of i3c-pp-scl-hi-period-ns.

  enable-hj:
    type: boolean
    description: |
      Enable SLVSTART interrupt for receiving hot-join request.

  hdr-ddr:
    type: boolean
    description: |
      Enable the i3c private transfers in hdr-ddr mode.

required:
  - compatible
  - reg
  - interrupts
  - clock-names
  - clocks

additionalProperties: true

examples:
  - |
    i3c-master@a0000000 {
        compatible = "silvaco,i3c-master-v1";
        clocks = <&zynqmp_clk 71>, <&fclk>, <&sclk>;
        clock-names = "pclk", "fast_clk", "slow_clk";
        interrupt-parent = <&gic>;
        interrupts = <0 89 4>;
        reg = <0xa0000000 0x1000>;
        #address-cells = <3>;
        #size-cells = <0>;
    };
```

## Documentation/devicetree/bindings/peci/peci-npcm.yaml
```yaml
# SPDX-License-Identifier: (GPL-2.0-only OR BSD-2-Clause)
%YAML 1.2
---
$id: http://devicetree.org/schemas/peci/peci-npcm.yaml#
$schema: http://devicetree.org/meta-schemas/core.yaml#

title: Nuvoton PECI Bus Device Tree Bindings

maintainers:
  - Tomer Maimon <tmaimon77@gmail.com>

allOf:
  - $ref: peci-controller.yaml#

properties:
  compatible:
    enum:
      - nuvoton,npcm750-peci
      - nuvoton,npcm845-peci

  reg:
    maxItems: 1

  interrupts:
    maxItems: 1

  clocks:
    description:
      Clock source for PECI controller. Should reference the APB
      clock.
    maxItems: 1

  cmd-timeout-ms:
    minimum: 1
    maximum: 1000
    default: 1000

  npcm,pull-down:
    description:
      This value determines the PECI I/O internal pull down
      operation.
    $ref: /schemas/types.yaml#/definitions/uint32
    minimum: 0
    maximum: 2
    default: 0

  npcm,host-neg-bit-rate:
    description:
      This value determines the host default negotiation
      bit rate.
    $ref: /schemas/types.yaml#/definitions/uint32
    minimum: 7
    maximum: 15
    default: 15

  nuvoton,sysgcr:
    $ref: /schemas/types.yaml#/definitions/phandle
    description: a phandle to access GCR registers.

  npcm,high-volt-range:
    type: boolean
    description:
      This value adapts PECI I/O interface to voltage
      range.

  syscon:
    maxItems: 1

required:
  - compatible
  - reg
  - interrupts
  - clocks

additionalProperties: false

examples:
  - |
    #include <dt-bindings/clock/nuvoton,npcm7xx-clock.h>
    #include <dt-bindings/interrupt-controller/arm-gic.h>

    peci-controller@f0100000 {
      compatible = "nuvoton,npcm750-peci";
      reg = <0xf0100000 0x200>;
      interrupts = <GIC_SPI 6 IRQ_TYPE_LEVEL_HIGH>;
      clocks = <&clk NPCM7XX_CLK_APB3>;
    };
...
```

## drivers/soc/nuvoton/Kconfig
```kconfig
# SPDX-License-Identifier: GPL-2.0-only

if ARCH_NPCM || COMPILE_TEST

menu "NUVOTON SoC drivers"

config NPCM_MBOX_CERBERUS
	tristate "NPCM CERBERUS Mailbox"
	depends on ARCH_NPCM || COMPILE_TEST
	depends on MAILBOX
	help
	  An implementation of the NPCM mailbox controller.
	  It is used to send message between the Core processor and other 
	  processors on the BMC such as TIP and CP. 
	  Select Y here if you want to use NPCM mailbox controller.

config MTD_NPCM_TIP_FIU
	tristate "Support NPCM TIP FIU"
	depends on ARCH_NPCM || COMPILE_TEST
	depends on MAILBOX
	depends on MTD
	help
	  This enables access to NOR device thourgh TIP in NPCM BMC's.

config NPCM_ESPI_VWGPIO
	tristate "NPCM eSPI Virtual Wire GPIO"
	depends on ARCH_NPCM || COMPILE_TEST
	help
	  An implementation of the NPCM eSPI virutal wire gpio driver.
	  It is used to control the virtual wire master-to-slave and
	  slave-to-master GPIO. It also registers an gpio controller
	  to handle the master-to-slave gpio event.
	  Select Y here if you want to use eSPI virtual wire gpio.

config NPCM_TIP_RNG
	tristate "Support NPCM TIP RNG"
	depends on ARCH_NPCM || COMPILE_TEST
	depends on MAILBOX
	depends on HW_RANDOM
	help
	  This enables access to HW RNG device thourgh TIP in NPCM BMC's.

endmenu

endif
```
